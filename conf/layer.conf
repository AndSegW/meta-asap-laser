## conf/layer.conf
```bitbake
# Diciamo a Yocto dove trovare le nostre "recipes" (ricette)
BBPATH .= ":${LAYERDIR}"

# Diciamo a Yocto quali file leggere dentro questo layer
BBFILES += "${LAYERDIR}/recipes-*/*/*.bb \
            ${LAYERDIR}/recipes-*/*/*.bbappend"

BBFILE_COLLECTIONS += "meta-asap-laser"
BBFILE_PATTERN_meta-asap-laser = "^${LAYERDIR}/"

# La priorità del nostro layer (da 1 a 10). 6 è lo standard, 
# se servirà sovrascrivere qualcosa degli altri layer, la alzeremo.
BBFILE_PRIORITY_meta-asap-laser = "6"

# Compatibilità con la versione di Yocto che stiamo usando (scarthgap)
LAYERDEPENDS_meta-asap-laser = "core"
LAYERSERIES_COMPAT_meta-asap-laser = "scarthgap"
```
